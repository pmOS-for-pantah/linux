## Documentation/devicetree/bindings/display/panel/samsung,s6e3fc3.yaml
```yaml
# SPDX-License-Identifier: GPL-2.0-only OR BSD-2-Clause
%YAML 1.2
---
$id: http://devicetree.org/schemas/display/panel/samsung,s6e3fc3.yaml#
$schema: http://devicetree.org/meta-schemas/core.yaml#

title: Samsung S6E3FC3 AMOLED DDIC

maintainers:
  - sidharthify <wednisegit@gmail.com>

description:
  The S6E3FC3 is a display driver IC with a connected AMOLED panel,
  driven over MIPI DSI in command mode with DSC compression.

allOf:
  - $ref: panel-common.yaml#

properties:
  compatible:
    items:
      - enum:
            # Samsung 6.3 inch, 1080x2400 pixels, Google Pixel 7
          - samsung,s6e3fc3-p10
      - const: samsung,s6e3fc3

  reg:
    maxItems: 1

  vci-supply:
    description: VCI regulator

  vddi-supply:
    description: VDDI regulator

required:
  - compatible
  - reg
  - reset-gpios
  - vci-supply
  - vddi-supply

unevaluatedProperties: false

examples:
  - |
    #include <dt-bindings/gpio/gpio.h>

    dsi {
        #address-cells = <1>;
        #size-cells = <0>;

        panel@0 {
            compatible = "samsung,s6e3fc3-p10", "samsung,s6e3fc3";
            reg = <0>;

            reset-gpios = <&gpa7 1 GPIO_ACTIVE_LOW>;
            vci-supply = <&ldo27m>;
            vddi-supply = <&bucka_s>;

            port {
                panel_in: endpoint {
                    remote-endpoint = <&dsi_out>;
                };
            };
        };
    };

...
```

## Documentation/devicetree/bindings/input/touchscreen/focaltech,ft3658.yaml
```yaml
# SPDX-License-Identifier: (GPL-2.0-only OR BSD-2-Clause)
%YAML 1.2
---
$id: http://devicetree.org/schemas/input/touchscreen/focaltech,ft3658.yaml#
$schema: http://devicetree.org/meta-schemas/core.yaml#

title: FocalTech FT3658 SPI touchscreen controller

maintainers:
  - sidharthify <wednisegit@gmail.com>

allOf:
  - $ref: touchscreen.yaml#
  - $ref: /schemas/spi/spi-peripheral-props.yaml#

properties:
  compatible:
    const: focaltech,ft3658

  reg:
    maxItems: 1

  interrupts:
    maxItems: 1

  reset-gpios:
    maxItems: 1

  avdd-supply:
    description: Analog power supply

  vdd-supply:
    description: Digital power supply

  spi-max-frequency:
    maximum: 10000000

required:
  - compatible
  - reg
  - interrupts
  - reset-gpios
  - avdd-supply
  - vdd-supply
  - touchscreen-size-x
  - touchscreen-size-y

unevaluatedProperties: false

examples:
  - |
    #include <dt-bindings/gpio/gpio.h>
    #include <dt-bindings/interrupt-controller/irq.h>

    spi {
        #address-cells = <1>;
        #size-cells = <0>;

        touchscreen@0 {
            compatible = "focaltech,ft3658";
            reg = <0>;
            spi-max-frequency = <10000000>;
            interrupt-parent = <&gpa7>;
            interrupts = <0 IRQ_TYPE_EDGE_FALLING>;
            reset-gpios = <&gpp23 2 GPIO_ACTIVE_LOW>;
            avdd-supply = <&ts_avdd>;
            vdd-supply = <&ts_vdd>;
            touchscreen-size-x = <1080>;
            touchscreen-size-y = <2400>;
        };
    };
```

## Documentation/devicetree/bindings/input/touchscreen/samsung,s6sy761.yaml
```yaml
# SPDX-License-Identifier: (GPL-2.0-only OR BSD-2-Clause)
%YAML 1.2
---
$id: http://devicetree.org/schemas/input/touchscreen/samsung,s6sy761.yaml#
$schema: http://devicetree.org/meta-schemas/core.yaml#

title: Samsung S6SY761 touchscreen controller

maintainers:
  - Andi Shyti <andi.shyti@kernel.org>
  - Lukas Timmermann <foss@timmermann.space>

allOf:
  - $ref: touchscreen.yaml#
  - $ref: /schemas/spi/spi-peripheral-props.yaml#

properties:
  compatible:
    enum:
      - samsung,s6sy761
      - samsung,s6sy791

  reg:
    maxItems: 1

  interrupts:
    maxItems: 1

  reset-gpios:
    maxItems: 1
    description: GPIO connected to the reset pin of the controller

  avdd-supply: true
  vdd-supply: true

  spi-max-frequency: true

  spi-cpha: true

  spi-cpol: true

unevaluatedProperties: false

required:
  - compatible
  - reg
  - interrupts
  - avdd-supply
  - vdd-supply

examples:
  - |
    #include <dt-bindings/interrupt-controller/irq.h>
    i2c {
        #address-cells = <1>;
        #size-cells = <0>;

        touchscreen@48 {
            compatible = "samsung,s6sy761";
            reg = <0x48>;
            interrupt-parent = <&gpa1>;
            interrupts = <1 IRQ_TYPE_LEVEL_HIGH>;
            avdd-supply = <&ldo30_reg>;
            vdd-supply = <&ldo31_reg>;
            touchscreen-size-x = <4096>;
            touchscreen-size-y = <4096>;
        };
    };

  - |
    #include <dt-bindings/gpio/gpio.h>
    #include <dt-bindings/interrupt-controller/irq.h>
    spi {
        #address-cells = <1>;
        #size-cells = <0>;

        touchscreen@0 {
            compatible = "samsung,s6sy791";
            reg = <0>;
            spi-max-frequency = <10000000>;
            spi-cpol;
            spi-cpha;
            interrupt-parent = <&gpa9>;
            interrupts = <0 IRQ_TYPE_LEVEL_LOW>;
            reset-gpios = <&gpp26 0 GPIO_ACTIVE_LOW>;
            avdd-supply = <&ldo26_reg>;
            vdd-supply = <&ldo25_reg>;
        };
    };
```

## Documentation/devicetree/bindings/leds/ti,lm3644.yaml
```yaml
# SPDX-License-Identifier: (GPL-2.0-only OR BSD-2-Clause)
%YAML 1.2
---
$id: http://devicetree.org/schemas/leds/ti,lm3644.yaml#
$schema: http://devicetree.org/meta-schemas/core.yaml#

title: Texas Instruments LM3644 dual LED flash driver

maintainers:
  - sidharthify <wednisegit@gmail.com>

description: |
  The LM3644 is a dual LED flash driver with an I2C interface. Each of its
  two current sinks can drive up to 1.5 A in flash mode and 179 mA in torch
  mode. Both sinks share the boost converter, mode bits and flash timer, so
  only one LED is supported, which can use one or both sinks.

  The data sheet can be found at:
    https://www.ti.com/lit/ds/symlink/lm3644.pdf

properties:
  compatible:
    const: ti,lm3644

  reg:
    maxItems: 1

  enable-gpios:
    maxItems: 1
    description: GPIO connected to the HWEN pin

  led:
    type: object
    $ref: common.yaml#
    unevaluatedProperties: false

    properties:
      led-sources:
        minItems: 1
        maxItems: 2
        items:
          enum: [1, 2]

      led-max-microamp:
        minimum: 977
        maximum: 179000

      flash-max-microamp:
        minimum: 10900
        maximum: 1500000

      flash-max-timeout-us:
        minimum: 10000
        maximum: 400000

    required:
      - led-sources

required:
  - compatible
  - reg
  - led

additionalProperties: false

examples:
  - |
    #include <dt-bindings/gpio/gpio.h>
    #include <dt-bindings/leds/common.h>

    i2c {
      #address-cells = <1>;
      #size-cells = <0>;

      led-controller@63 {
        compatible = "ti,lm3644";
        reg = <0x63>;
        enable-gpios = <&gpio1 2 GPIO_ACTIVE_HIGH>;

        led {
          function = LED_FUNCTION_FLASH;
          color = <LED_COLOR_ID_WHITE>;
          led-sources = <1>, <2>;
          led-max-microamp = <89300>;
          flash-max-microamp = <729000>;
          flash-max-timeout-us = <400000>;
        };
      };
    };
```

## Documentation/devicetree/bindings/mfd/samsung,s2mpg12-pmic.yaml
```yaml
# SPDX-License-Identifier: GPL-2.0-only OR BSD-2-Clause
%YAML 1.2
---
$id: http://devicetree.org/schemas/mfd/samsung,s2mpg12-pmic.yaml#
$schema: http://devicetree.org/meta-schemas/core.yaml#

title: Samsung S2MPG12 Power Management IC

maintainers:
  - sidharthify <wednisegit@gmail.com>

description: |
  The Samsung S2MPG12 is the main Power Management IC of Google gs201 based
  boards. It has buck converters, LDOs, a real time clock and power meters,
  and is accessed through the ACPM firmware of the SoC.

properties:
  compatible:
    const: samsung,s2mpg12-pmic

  interrupts:
    maxItems: 1

  regulators:
    type: object
    description:
      List of child nodes that specify the regulators.

    patternProperties:
      "^ldo([1-9]|1[0-9]|2[0-8])m$":
        type: object
        $ref: /schemas/regulator/regulator.yaml#
        unevaluatedProperties: false

    additionalProperties: false

  wakeup-source: true

required:
  - compatible
  - interrupts
  - regulators

additionalProperties: false
```

## drivers/soc/google/Kconfig
```kconfig
# SPDX-License-Identifier: GPL-2.0-only

if ARCH_EXYNOS || COMPILE_TEST

menu "Google SoC drivers"

endmenu

endif
```
